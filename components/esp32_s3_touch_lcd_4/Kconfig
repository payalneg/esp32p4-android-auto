## components/h264dec/Kconfig
```kconfig
menu "H.264 decoder (AA video)"

    config H264DEC_OWN
        bool "Use the in-tree h264bsd decoder instead of esp_h264's prebuilt tinyh264"
        default y
        help
            h264_pipe decodes with components/h264dec (Hantro h264bsd built from
            source at -O2, with the P_Skip fast path and the unchanged-picture
            signal). Off = the prebuilt libtinyh264.a inside esp_h264, kept for
            A/B measurements.

    config H264DEC_STATS
        bool "Per-stage decode timing in the h264_pipe stats line"
        default y
        depends on H264DEC_OWN
        help
            h264dec accumulates the time spent in slice decoding vs the
            deblocking pass per picture; h264_pipe prints the averages every
            stats window. Costs two esp_timer reads per picture.

endmenu
```

## components/log_capture/Kconfig
```kconfig
menu "Log capture"

    config LOG_CAPTURE_SIZE_KB
        int "Boot-log ring buffer size (KiB, PSRAM)"
        default 256 if IDF_TARGET_ESP32S3
        default 1024
        range 32 4096
        help
            Every ESP_LOG line is mirrored into this PSRAM ring so the Logs
            screen and the companion app can show the boot log after the fact.
            Allocated once at the very start of app_main and never freed.

            1 MiB is comfortable on the P4 boards (32 MiB PSRAM). The ESP32-S3
            board has 8 MiB total and spends 0.9 MiB of it on the two LCD frame
            buffers plus up to ~3 MiB on an OTA image being staged, so it takes
            a quarter of that.

endmenu
```
