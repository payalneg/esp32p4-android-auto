## components/c6_ota_partition/Kconfig
```kconfig
menu "C6 Slave OTA (partition)"

    config C6_OTA_ENABLED
        bool "Run slave OTA on boot if version differs"
        default y

    config C6_OTA_DISPLAY_PROGRESS
        bool "Show LVGL progress screen during OTA"
        depends on C6_OTA_ENABLED
        default n
        help
            Initializes BSP display and renders an OTA progress bar.
            Disable if the LCD/MIPI-DSI panel is not wired or the BSP
            driver hangs on initial readback (then OTA still runs,
            progress shows up in the serial log only).

    config C6_OTA_FORCE
        bool "Force C6 OTA every boot (debug)"
        depends on C6_OTA_ENABLED
        default n
        help
            Skip the version check and always run OTA on boot. For
            verifying the OTA pipeline + progress UI without bumping
            the slave firmware version. Leave OFF in production.

endmenu
```

## components/esp32_p4_jc4880p433c_bsp/Kconfig
```kconfig
menu "JC4880P443C BSP Configuration"

    menu "Display Configuration"
        config BSP_JC4880P443C_LCD_H_RES
            int "Horizontal resolution"
            default 480
            help
                Horizontal resolution of the LCD panel in pixels.

        config BSP_JC4880P443C_LCD_V_RES
            int "Vertical resolution"
            default 800
            help
                Vertical resolution of the LCD panel in pixels.

        config BSP_JC4880P443C_DSI_LANE_BITRATE
            int "DSI lane bitrate (Mbps)"
            default 500
            range 200 1000
            help
                MIPI DSI lane bitrate in Mbps. Higher values support faster refresh rates
                but may cause signal integrity issues. 500 Mbps is recommended for this panel.

        config BSP_JC4880P443C_DPI_CLOCK_MHZ
            int "DPI clock frequency (MHz)"
            default 34
            range 20 100
            help
                DPI (Display Pixel Interface) clock frequency in MHz.
                This affects the refresh rate. 34 MHz gives ~60Hz refresh rate.

        config BSP_JC4880P443C_NUM_FB
            int "Number of frame buffers"
            default 2
            range 1 3
            help
                Number of frame buffers for display. 2 buffers enable double buffering
                for smoother animations, but use more memory.
    endmenu

    menu "Backlight Configuration"
        config BSP_JC4880P443C_LCD_BL_GPIO
            int "Backlight control GPIO"
            default 23
            help
                GPIO pin connected to the backlight control (PWM).

        config BSP_JC4880P443C_BACKLIGHT_PWM_FREQ
            int "Backlight PWM frequency (Hz)"
            default 20000
            range 1000 50000
            help
                PWM frequency for backlight control. Higher frequencies reduce
                visible flicker but may increase power consumption.

        config BSP_JC4880P443C_BACKLIGHT_TIMER
            int "LEDC timer number for backlight"
            default 1
            range 0 3
            help
                LEDC timer number used for backlight PWM control.

        config BSP_JC4880P443C_BACKLIGHT_CHANNEL
            int "LEDC channel number for backlight"
            default 1
            range 0 7
            help
                LEDC channel number used for backlight PWM control.
    endmenu

    menu "Touch Configuration"
        config BSP_JC4880P443C_I2C_SCL_GPIO
            int "I2C SCL GPIO"
            default 8
            help
                GPIO pin for I2C clock signal (SCL) connected to touch controller.

        config BSP_JC4880P443C_I2C_SDA_GPIO
            int "I2C SDA GPIO"
            default 7
            help
                GPIO pin for I2C data signal (SDA) connected to touch controller.

        config BSP_JC4880P443C_I2C_FREQ_HZ
            int "I2C frequency (Hz)"
            default 400000
            help
                I2C bus frequency for touch controller communication.
    endmenu

    menu "LVGL Configuration"
        config BSP_JC4880P443C_LVGL_BUFFER_SIZE
            int "LVGL buffer size (pixels)"
            default 76800
            help
                Size of LVGL display buffer in pixels. Recommended: 480*160 = 76800
                for good performance/memory balance.

        config BSP_JC4880P443C_LVGL_DOUBLE_BUFFER
            bool "Use LVGL double buffering"
            default y
            help
                Enable double buffering in LVGL for smoother display updates.
                Requires more memory but provides better visual experience.

        config BSP_JC4880P443C_LVGL_AVOID_TEAR
            bool "Enable avoid tearing feature"
            default n
            help
                Enable LVGL avoid tearing feature. May improve display quality
                but can impact performance on some panels.
    endmenu

    menu "Power Management"
        config BSP_JC4880P443C_DSI_PHY_LDO_CHANNEL
            int "DSI PHY LDO channel"
            default 3
            range 1 4
            help
                LDO channel used to power the MIPI DSI PHY.

        config BSP_JC4880P443C_DSI_PHY_VOLTAGE_MV
            int "DSI PHY voltage (mV)"
            default 2500
            range 1800 3300
            help
                Voltage level for MIPI DSI PHY in millivolts. 2500mV (2.5V) is
                the recommended voltage for this hardware.
    endmenu

    menu "Hardware Reset"
        config BSP_JC4880P443C_LCD_RST_GPIO
            int "LCD reset GPIO"
            default 5
            help
                GPIO pin connected to LCD panel reset signal.
    endmenu

endmenu
```

## main/Kconfig.projbuild
```kconfig
menu "Android Auto Head Unit"

    choice BOARD_MODEL
        prompt "Target hardware board"
        default BOARD_WAVESHARE_43
        help
            Selects the physical head-unit board. Drives board-specific GPIO
            pins (LCD backlight/reset, I2S, BT-agent UART) and MIPI-DSI panel
            timing that can't be expressed through plain Kconfig — see the
            CONFIG_BOARD_* #if branches in the BSP and main/bt_link.h.

            This choice alone does NOT set flash size / partition table / CAN
            pins; those live in the per-board sdkconfig.defaults.<board> overlay
            (see scripts/build_board.sh). Keep them in lockstep with this choice.

        config BOARD_WAVESHARE_43
            bool "Waveshare ESP32-P4-WIFI6-Touch-LCD-4.3 (32 MB flash)"

        config BOARD_JC4880P443C
            bool "Guition JC4880P443C_I_W (16 MB flash)"
    endchoice

    choice AA_WIFI_ROLE
        prompt "WiFi role"
        default AA_WIFI_ROLE_AP
        help
            Real Android Auto head units run as the WiFi access point
            (the phone joins the head unit's network). STA mode is only
            useful for bench testing where both devices share an
            existing WiFi network.

        config AA_WIFI_ROLE_AP
            bool "SoftAP (production)"

        config AA_WIFI_ROLE_STA
            bool "Station — connect to existing WiFi (bench test only)"
    endchoice

    config AA_AP_SSID_PREFIX
        string "AP SSID prefix"
        depends on AA_WIFI_ROLE_AP
        default "AAHU"
        help
            Last 4 hex digits of the MAC are appended, e.g. "AAHU-1A2B".

    config AA_AP_PASSWORD
        string "AP password (WPA2-PSK, min 8 chars)"
        depends on AA_WIFI_ROLE_AP
        default "12345678"

    config AA_AP_CHANNEL
        int "AP channel (1-13)"
        depends on AA_WIFI_ROLE_AP
        default 6
        range 1 13

    config AA_WIFI_SSID
        string "Bench WiFi SSID"
        depends on AA_WIFI_ROLE_STA
        default "myssid"

    config AA_WIFI_PASSWORD
        string "Bench WiFi password"
        depends on AA_WIFI_ROLE_STA
        default "mypassword"

    config AA_WIFI_MAX_RETRY
        int "Maximum STA connect retries"
        depends on AA_WIFI_ROLE_STA
        default 10

    config AA_OVERCLOCK_400
        bool "Overclock CPU to 400 MHz (unsupported on rev <3.0)"
        default n
        help
            ESP32-P4 silicon ≤ rev 1.x is officially capped at 360 MHz in
            ESP-IDF. The CPLL is physically capable of 400 MHz on most
            engineering samples but Espressif provides no guarantees.
            With this option enabled, app_main reprograms CPLL to 400 MHz
            and switches CPU divider to 1 right after NVS init.
            Disable this if the chip becomes unstable or refuses to boot.

    menu "BT Agent OTA (Mode A)"

        config BT_AGENT_OTA_ENABLED
            bool "Reflash BT agent on version mismatch"
            default n
            help
                On boot, parse the agent's BT-VER:<version> line and compare
                to BT_AGENT_FW_VERSION below. On mismatch, force the D1 Mini
                into ROM bootloader (via GPIO24/25) and reflash from the
                binary embedded at components/bt_agent_fw/bt_agent_fw.bin.
                Uses the espressif/esp_serial_flasher managed component.

                Build will fail with a clear error if enabled without the
                binary present. To disable OTA without removing the binary,
                just keep this option n.

        config BT_AGENT_FW_VERSION
            string "Expected BT agent firmware version"
            depends on BT_AGENT_OTA_ENABLED
            default "0.6.3"
            help
                Must exactly match what the agent emits on boot via
                `BT-VER:<version>`. Bump this in lockstep with the agent
                firmware build. If the agent reports a different value
                (or no value within BT_AGENT_VERSION_TIMEOUT_MS), OTA fires.

        config BT_AGENT_VERSION_TIMEOUT_MS
            int "Timeout waiting for BT-VER: line (ms)"
            depends on BT_AGENT_OTA_ENABLED
            default 3000
            range 500 30000
            help
                If the agent doesn't emit a BT-VER: line within this window
                after bt_link_init's reset, treat it as a missing/broken
                firmware and trigger OTA. Bump if the agent's app is slow
                to start (NVS scan, sensor init, etc.).

        config BT_AGENT_FLASH_BAUD
            int "Flasher baud rate during OTA"
            depends on BT_AGENT_OTA_ENABLED
            default 460800
            help
                ROM/stub bootloader sync is always at 115200, then renegotiates
                up to this rate for the actual write. 460800 over short
                direct UART wires is the usual sweet spot; 921600 also
                works but cuts error margin. Drop to 115200 if you suspect
                signal-integrity issues on a long noisy line.

    endmenu

    menu "OTA over WiFi"

        config OTA_HTTP_ENABLED
            bool "Enable HTTP OTA server"
            default y
            help
                Starts a small HTTP server (default port 80) on the SoftAP
                interface after WiFi is up. POST the new app binary to
                /ota and the device will flash the inactive OTA slot and
                reboot. See scripts/ota_push.sh.

        config OTA_HTTP_PORT
            int "OTA HTTP port"
            depends on OTA_HTTP_ENABLED
            default 80
            range 1 65535

    endmenu

    config DEBUG_UART_BRIDGE
        bool "UART0 debug bridge (screenshot + touch injection)"
        default n
        help
            Registers esp_console commands on the UART0 console for host-driven
            UI test automation (scripts/uart_debug.py):
              screenshot  — capture lv_scr_act() and stream it back as a
                            base64-framed JPEG (HW-encoded) or raw RGB565,
                            with logging muted during the transfer.
              tap / swipe / touchdown|up|move — inject synthetic LVGL pointer
                            events in landscape coords (0..799 x 0..479).

            Costs flash (esp_console + JPEG encoder) and ~1 MB PSRAM (lazily
            allocated on first screenshot). Also forces LV_USE_SNAPSHOT on.
            Leave OFF for production / OTA-tight builds (e.g. jc4880).

    config DEBUG_UART_BRIDGE_JPEG_QUALITY
        int "Default screenshot JPEG quality (1-100)"
        depends on DEBUG_UART_BRIDGE
        default 80
        range 1 100

endmenu
```
